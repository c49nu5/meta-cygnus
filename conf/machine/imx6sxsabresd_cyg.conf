## conf/machine/imx6sxsabresd_cyg.conf
```bitbake
#@TYPE: Machine
#@NAME: Freescale i.MX6SoloX SabreSD CYGNUS BSP
#@SOC: i.MX6SX
#@DESCRIPTION: Machine configuration for Freescale i.MX6SoloX Sabre SD Cygnus BSP
#@MAINTAINER: David George <david@cygnus-instruments.com.

require conf/machine/include/imx6sabresd-common.inc

MACHINE_FEATURES = "apm usbgadget usbhost vfat"
MACHINE_FEATURES_remove = "wifi pci alsa touchscreen bluetooth"
# NB. I have removed : wifi pci alsa touchscreen bluetooth

SOC_FAMILY = "mx6:mx6sx"

KERNEL_IMAGETYPE = "zImage"

# Define our own custom device tree
KERNEL_DEVICETREE = "imx6sx-sdb-cygnus.dtb"
#KERNEL_DEVICETREE = "imx6sx-sdb.dtb"

# Define our own custom u-boot machine
#UBOOT_MACHINE = "mx6sxsabresd_cyg_config"
UBOOT_MACHINE = "mx6sxsabresd_config"

IMAGE_FSTYPES = "sdcard"
```
